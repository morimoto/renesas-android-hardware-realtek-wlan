## rtl8812au_km/Kconfig
```kconfig
mainmenu "Wi-Fi Realtek Driver Configuration"

choice
	prompt "Interface type"
	default CONFIG_USB_HCI
	help
		Config for dongle connecting interface.

config CONFIG_USB_HCI
	bool "USB"
	help
		Choose it in case of USB Wi-Fi dongle.

config CONFIG_PCI_HCI
	bool "PCI"
	help
		Choose it in case of PCI Wi-Fi adapter.

config CONFIG_SDIO_HCI
	bool "SDIO"
	help
		Choose it in case of SDIO Wi-Fi adapter.

config CONFIG_GSPI_HCI
	bool "GSPI"
	help
		Choose it in case of GSPI Wi-Fi adapter.

endchoice # "Interface type"

choice
	prompt "Chipset"
	default CONFIG_RTL8812A
	help
		Choose chipset, installed in your adapter.

config CONFIG_RTL8812A
	bool "RTL8812A"

config CONFIG_RTL8814A
	bool "RTL8814A"

config CONFIG_RTL8192E
	bool "RTL8192E"

config CONFIG_RTL8723B
	bool "RTL8723B"

config CONFIG_RTL8723C
	bool "RTL8723C"

config CONFIG_RTL8821C
	bool "RTL8821C"

config CONFIG_RTL8822B
	bool "RTL8822B"

endchoice # "Chipset"


menu "Power consumption"

config CONFIG_POWER_SAVING
	bool "Power saving mode"
	default false
	help
		Enable power saving mode for dongle.

config CONFIG_USB2_EXTERNAL_POWER
	bool "USB 2.0 consumption limitatition"
	default false
	help
		False means that port support supply current over 500mA,
		so no limitation in Power by Rate.

config CONFIG_USB_AUTOSUSPEND
	bool "Enable USB autosuspend"
	default false
	help
		This feature enable USB autosuspend while dongle is idle.

config CONFIG_HW_PWRP_DETECTION
	bool "Enable hardware power pin detection"
	default false
	help
		Enable power down function via power pin.

endmenu # "Power consumption"

menu "Features"


config CONFIG_BT_COEXIST
	bool "Bluetotooth co-exist"
	depends on CONFIG_RTL8723B
	default false
	help
		Enable Wi-Fi and Bluetooth co-existing.

config CONFIG_TDLS
	bool "Tunneled Direct Link Setup"
	default false
	help
		Enable TDLS - way to stream data faster between
		devices on the same network.

config CONFIG_EFUSE_CONFIG_FILE
	bool "Use eFuse external file"
	default true
	help
		eFuse is a technology invented by IBM which allows for the
		dynamic real-time reprogramming of computer chips.

config CONFIG_80211W
	bool "Enable 802.11w standard support"
	default true
	help
		IEEE 802.11w is the Protected Management Frames standard for
		the IEEE 802.11 family of standards. TGw is working on improving
		the IEEE 802.11 Medium Access Control layer. The objective of this
		is to increase the security by providing data confidentiality of
		management frames, mechanisms that enable data integrity, data
		origin authenticity, and replay protection.

config CONFIG_NET_NS
	bool "Network namespace support"
	default true
	help
		Allow user space to create what appear to be multiple instances of
		the network stack.

config CONFIG_BR_EXT
	bool "External network bridge"
	depends on CONFIG_NET_NS
	default true
	help
		Enable creating of external network bridge.

config CONFIG_ENABLE_DRIVER_WARNINGS
	bool "Enable driver debug warnings"
	default false
	help
		This feature enable driver debug warning. That is useful for
		informing developer about some unexpected but not critical
		situations in driver runtime.


endmenu # "Features"
```

## rtl8812au_km/configs/rcar_defconfig
```kconfig
CONFIG_USB2_EXTERNAL_POWER=y
CONFIG_EFUSE_CONFIG_FILE=y
CONFIG_80211W=y
CONFIG_IOCTL_CFG80211=y
CONFIG_RTW_USE_CFG80211_STA_EVENT=y
CONFIG_RADIO_WORK=y
CONFIG_CONCURRENT_MODE=y
```
